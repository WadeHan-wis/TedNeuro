## prj.conf
```kconfig
# Rev0 | 기본 Zephyr(NCS) 스캐폴드 설정
# 보드/드라이버 세부 설정(NRFX_RTC 인스턴스, I2C, PWM, BT 등)은
# 실제 보드가 확정된 뒤 devicetree overlay(Application/app.overlay)와 함께 추가한다
# (architecture.md §11).

CONFIG_LOG=y
CONFIG_LOG_MODE_DEFERRED=y

# pinmap.md: PoC v1은 UART 핀이 노출되어 있지 않다 (SWD만 사용 가능) — 로그는
# UART 콘솔이 아니라 RTT(디버그 인터페이스로 전송)로만 확인 가능하다.
CONFIG_USE_SEGGER_RTT=y
CONFIG_LOG_BACKEND_RTT=y
CONFIG_LOG_BACKEND_UART=n

# 기본 RTT up-buffer(1KB)는 "연결 중엔 로깅 안 함 -> 끊긴 뒤 한꺼번에 dump" 방식(m_ble_proto.c,
# 2026-09-15)과 맞지 않는다 — 세션 내내 아무도 안 읽고 있다가 disconnect 시점에 몰아서 로그를
# 찍으면 SEGGER_RTT_MODE_NO_BLOCK_SKIP(기본값) 특성상 버퍼가 가득 차서 뒷부분(정작 필요한
# write dump)이 유실됨을 실기에서 확인. 버퍼를 키워서 한 세션 분량 로그가 다 들어가게 한다.
# 이 버퍼는 "연결 없이 방치"용이라 buffer index 0(기본 terminal up-buffer) 기준으로 이
# 값(SEGGER_RTT_BUFFER_SIZE_UP)이 실제 크기를 결정한다 — LOG_BACKEND_RTT_BUFFER_SIZE는
# LOG_BACKEND_RTT_BUFFER>0(전용 버퍼 인덱스)일 때만 적용되는 별개 옵션이라 우리 구성(버퍼
# 인덱스 0 그대로 사용)에서는 의미가 없다(2026-09-28 확인, RTT 모드 재검토 중 교차검증).
CONFIG_SEGGER_RTT_BUFFER_SIZE_UP=4096

# [정정, 2026-09-28] Zephyr 로그 백엔드(LOG_BACKEND_RTT_MODE)는 위 SEGGER_RTT_MODE_UP과
# 완전히 별개 설정이다 — 지금까지 명시적으로 안 정해서 Zephyr 기본값인 MODE_BLOCK으로
# 동작하고 있었다(재시도 4회×5ms 후 드롭, log_backend_rtt.c 확인). CONFIG_LOG_MODE_DEFERRED
# 덕분에 이게 m_i2c/m_ble/m_ctrl 태스크를 막지는 않지만(로깅 전용 스레드만 재시도로 도는
# 구조), J-Link 연결 없이 오래 방치하면 매 로그 메시지마다 20ms씩 허비하고 결국 버림 — 즉
# "한참 뒤에 연결해서 그동안 쌓인 걸 본다"는 우리 실사용 시나리오에서 사실상 아무것도 안
# 쌓인다. OVERWRITE로 바꾸면 SEGGER_RTT_WriteWithOverwriteNoLock()을 직접 써서(SEGGER_RTT_MODE
# 설정과 무관하게 자체적으로 덮어쓰기 동작) 재시도 없이 즉시 기록하고, 버퍼가 차면 가장
# 오래된 로그부터 덮어써서 "최근 상황"이 항상 남는다 — watchdog fault injection/sensor
# fault recovery/배터리 자연방전처럼 장시간 무인 방치 후 이상 시점 직전 로그를 보는 우리
# 용도에 맞다(reset 자체의 원인은 RTT가 아니라 m_ctrl.c log_reset_cause()가 별도로
# GPREGRET 없이도 RESETREAS 레지스터로 다음 부팅 시 잡아준다 — RTT는 "전원 유지된 채
# 방치" 시나리오만 커버).
CONFIG_LOG_BACKEND_RTT_MODE_OVERWRITE=y

# DCDC(벅 컨버터) 레귤레이터 활성화(2026-09-28) — 기본값은 LDO(선형 레귤레이터, 남는
# 전압을 열로 버림)인데, 우리 보드는 이미 DCDC용 인덕터가 실장돼 있다(pinmap.md §5
# "DC/DC(DCC) pin47, L3(15nH)+L4(10uH)"). 데이터시트 기준 TX 전류가 거의 절반으로
# 줄어든다(0dBm 기준 11.6mA(LDO)→5.3mA(DCDC)). §8 배터리 8h 목표와 직결된 전력 최적화.
# [정정] CONFIG_SOC_DCDC_NRF52X는 이 NCS 버전에서 deprecated(prompt 없는 내부 심볼이라
# prj.conf에서 직접 대입 불가, 실제로 west build 에러로 확인) — devicetree
# (Application/app.overlay `&reg` 노드, regulator-initial-mode)로 설정한다.
# 전원부 전체에 영향을 주는 변경이라 실기 전류소비(AT-06)/전압 리플/기능 회귀(I2C·BLE)
# 검증 전까지는 "설정 켬"만으로 완료 처리하지 않는다.

CONFIG_MAIN_STACK_SIZE=2048

# m_ctrl_request_reset()의 sys_reboot() 호출에 필요 (architecture.md §3)
CONFIG_REBOOT=y

# Watchdog (Rev3, R3-1, 2026-09-16) — nRF52832 wdt0는 SoC dts에서 기본 status=okay라
# devicetree overlay 없이 이 옵션만으로 사용 가능 (m_ctrl.c 참고).
CONFIG_WATCHDOG=y

# RTC2를 nrfx로 직접 제어하기 위해 활성화 (architecture.md §2.3).
# 이 NCS 버전은 인스턴스별 Kconfig가 없고 NRFX_RTC 하나로 전체 RTC 드라이버를 켠다.
# IRQ 연결은 m_i2c_rtc.c에서 IRQ_CONNECT()로 직접 처리한다 (실기 검증 완료, 2026-09-14).
CONFIG_NRFX_RTC=y

# 클럭 트리 재계산 검증(2026-09-28, 트래커 "0. Baseline & Handover" 2번 항목) — LFCLK 소스는
# CONFIG_CLOCK_CONTROL_NRF_K32SRC_XTAL이 기본값이라 이미 맞지만(pinmap.md §7 LFXO
# ECS-.327-12.5-12-TR, 외부 크리스탈 실장 확인), 정확도(ppm) 선언은 지금까지 손 안 대서
# Zephyr 기본값인 CLOCK_CONTROL_NRF_K32SRC_50PPM(31~50ppm)으로 남아있었다. 실제 실장
# 부품 데이터시트(ECS Inc. ECS-.327-12.5-12-TR) 기준 정확도는 **±20ppm**이라, 더 정확한
# CLOCK_CONTROL_NRF_K32SRC_20PPM으로 정정한다. 이 값은 BLE 컨트롤러가 연결 이벤트마다
# RX 윈도우를 얼마나 넓힐지(클럭 drift 보정 마진) 계산하는 데 쓰인다 — 과대평가(50ppm)
# 상태로 두면 안전하지만(더 넓게 여니 통신 실패 위험은 없음), RX 윈도우가 필요 이상으로
# 넓어져 라디오 on-time이 늘고 전력을 더 쓴다. 8h 배터리 목표(§8)와 관련된 낮은 리스크의
# 전력 최적화 항목.
CONFIG_CLOCK_CONTROL_NRF_K32SRC_20PPM=y

# BLE TX power -8dBm 기본값. m_ble.c의 HCI VS Write TX Power는 BT_CTLR_TX_PWR_DYNAMIC_CONTROL이
# 꺼져 있으면 컨트롤러가 Unknown Command(0x01)로 거부해서 적용되지 않으므로, 컨트롤러 기본값으로 건다.
CONFIG_BT_CTLR_TX_PWR_MINUS_8=y

# LED PWM 구동 (pinmap.md §2, app.overlay의 pwm0 노드). PoC v1 실기 검증 완료(v0.0.3).
CONFIG_PWM=y

# AS7341 NIR1 I2C 드라이버 (pinmap.md §3, app.overlay의 i2c1 노드).
CONFIG_I2C=y

# BLE 실 스택 착수 (2026-09-15) — 테스트 APK(fnirs-visualizer-app-release.apk) 호환
# 연동이 목적이라, 정식 프로덕션 프로토콜(S2 정책: Tx power -8dBm 고정, MTU 251byte 등)은
# 아직 적용하지 않는다 (m_ble.c TODO 참고).
CONFIG_BT=y
CONFIG_BT_PERIPHERAL=y
# [정책, 2026-09-22] 사용자 결정: 앞으로 이 값을 "TedNeuro_v{MAJOR}.{MINOR}.{PATCH}"
# 형식으로 매 패치 버전 상승 시 config_app.h(FW_VERSION_*)/Application/VERSION과
# 함께 갱신한다 — BLE 스캔/연결 시 앱이 디바이스 이름만 보고도 어떤 펌웨어 버전인지
# 바로 구분할 수 있게 하기 위함(advertising scan response에도 이 값이 그대로 실림,
# m_ble.c s_scan_rsp_data 참고). Kconfig 문자열이라 빌드 타임에 C 매크로를 자동
# 대입할 수는 없어 수동으로 맞춘다 — VERSION 파일 동기화와 동일한 패턴.
CONFIG_BT_DEVICE_NAME="TedNeuro_v1.0.0"

# [전력 최적화, 2026-09-21] 배칭(m_ble_proto.h v3)을 위해 MTU 협상/LE Data Length
# Update를 우리(peripheral)가 먼저 요청한다(m_ble.c on_connected() 참고).
# - BT_GATT_CLIENT: bt_gatt_exchange_mtu() 호출에 필요(GAP 역할과 무관하게 ATT MTU
#   교환은 GATT client 절차로 분류됨).
# - BT_USER_DATA_LEN_UPDATE: bt_conn_le_data_len_update() 호출에 필요. 실제 무선 PDU
#   크기(최대 251byte)는 컨트롤러가 이미 지원(CONFIG_BT_CTLR_DATA_LENGTH_MAX=251,
#   CONFIG_BT_BUF_ACL_TX_SIZE=251 등 board defconfig 기본값 확인됨, 2026-09-21) —
#   이 옵션은 그 능력을 "먼저 요청"하는 API만 켠다.
CONFIG_BT_GATT_CLIENT=y
CONFIG_BT_USER_DATA_LEN_UPDATE=y

# Safety 인증 대응(2026-09-17, architecture.md §11 항목6-[5]): BLE 페어링/본딩/암호화
# 설계는 준비하되, 테스트 APK가 본딩을 지원하는지 미확인 상태라 비활성으로 둔다.
# 활성화 시 m_ble_gatt.c의 BT_UUID_AS7341_CONFIG/DATA0/DATA1 characteristic permission을
# BT_GATT_PERM_*_ENCRYPT로 바꿔야 실제로 암호화가 강제된다 (앱 본딩 지원 확인 후 진행).
# 2026-09-21: 실제로 활성화했다가(v0.1.15) 같은 날 사용자 결정으로 롤백 — 지금 단계에서는
# "끊기면 advertising 재개 후 재연결"만 되면 충분하고(기존 구조로 이미 동작), 본딩까지는
# 아직 필요 없다고 판단. 재검토 시 CHANGELOG.md v0.1.15(롤백됨) 참고.
# CONFIG_BT_SMP=y
# CONFIG_BT_BONDABLE=y

# OTA(DFU) — Safety 인증 대응(2026-09-17, architecture.md §11 항목6-[6]): MCUboot 골격
# (sysbuild.conf) 위에 SMP-over-BLE 이미지 관리 활성화. 서명키는 sysbuild 기본
# 자동생성 디버그 키 사용(프로덕션 키 관리는 별도 범위, architecture.md §11 보류 항목).
# 실기 업데이트/롤백/강제전원차단 3-시나리오 검증은 하드웨어 검증 단계에서 진행한다.
# 2026-09-17 OTA 실기 테스트 중 "GATT ERROR"로 업데이트 실패 — 원인은 손으로 하나씩
# 넣은 위 설정에 MCUMGR_TRANSPORT_BT_REASSEMBLY(SMP 패킷 재조립, 기본 ATT MTU=23byte로는
# 큰 업로드 요청이 여러 조각으로 나뉘는데 재조립 없이는 깨짐)가 빠져 있었기 때문으로
# 추정. NCS가 제공하는 공식 검증 번들(samples/common/mcumgr_bt_ota_dfu/Kconfig)로
# 교체 — reassembly/버퍼크기/연결파라미터 제어를 한 번에 올바르게 설정해준다.
# BT_SMP 비활성 상태에서는 MCUMGR_TRANSPORT_BT_PERM이 자동으로 암호화 불필요
# 옵션(_RW)을 선택한다 — 위 [5]의 보안 비활성 결정과 일관됨.
CONFIG_NCS_SAMPLE_MCUMGR_BT_OTA_DFU=y
CONFIG_NCS_SAMPLE_MCUMGR_BT_OTA_DFU_SPEEDUP=y

# Watchdog 리셋 후 안전 재시작 시퀀스(2026-09-17, architecture.md §11 항목6-[2]) —
# RESETREAS 레지스터로 이전 리셋 원인을 읽기 위함 (m_ctrl.c log_reset_cause() 참고).
CONFIG_HWINFO=y

# 모듈 오류 재부팅 에스컬레이션(2026-09-29, config_app.h CTRL_MODULE_FAULT_REBOOT_MAX
# 참고) — 재부팅 횟수를 GPREGRET(POR 전까지 유지)에 저장하기 위한 retained_mem 드라이버.
# gpregret1 devicetree 노드는 nrf52832.dtsi에 이미 status="okay"라 overlay 불필요.
CONFIG_RETAINED_MEM=y
```

## include/config_app.h
```c
/*
 * Rev0 | Application-wide configuration constants
 * Task priorities, RTC/timing constants, wavelength definitions.
 * architecture.md §2, §4, §5 참고.
 */
#ifndef CONFIG_APP_H_
#define CONFIG_APP_H_

#ifdef __cplusplus
extern "C" {
#endif

/* --- 보드(PoC v1) 펌웨어 버전 ---
 * v0.0.1부터 시작, 패치 적용마다 PATCH를 1씩 올린다 (v0.0.1 → v0.0.2 → ...).
 * 2026-09-17: OTA(무선 펌웨어 업데이트) 실기 검증 성공을 기점으로 v0.1.1부터
 * MINOR를 1로 올려 새 관리 기준선으로 삼는다(Application/VERSION 파일과 반드시
 * 함께 갱신 — MCUboot 이미지 버전은 이 값이 아니라 그 파일을 따로 읽는다,
 * CHANGELOG.md v0.0.15 참고). 이후 패치는 v0.1.1 → v0.1.2 → ...
 * 버전 이력은 CHANGELOG.md 참고.
 */
#define FW_VERSION_MAJOR 1
#define FW_VERSION_MINOR 0
#define FW_VERSION_PATCH 0

/* nirs_sample_t.fw_version(uint16_t)에 담기 위한 패킹: MAJOR(4bit)|MINOR(4bit)|PATCH(8bit) */
#define FW_VERSION_PACKED \
	(((FW_VERSION_MAJOR & 0xF) << 12) | ((FW_VERSION_MINOR & 0xF) << 8) | \
	 (FW_VERSION_PATCH & 0xFF))

/* --- Task priorities (Zephyr preemptive, lower number = higher priority) ---
 * architecture.md §2.2 / codingstandard.md §4: I2C(Acquisition) > BLE TX > Control
 * 현재 구현 대상은 3개 태스크(m_i2c/m_ble/m_ctrl)로 한정한다.
 * Battery/Temperature, Logging 태스크는 아직 구현하지 않는다.
 */
#define I2C_TASK_PRIORITY    2
#define BLE_TASK_PRIORITY 	 4
#define CTRL_TASK_PRIORITY   6

#define I2C_TASK_STACK_SIZE    2048
#define BLE_TASK_STACK_SIZE    2048	
#define CTRL_TASK_STACK_SIZE   1024

/* --- Sampling / RTC timing (architecture.md §2.3) ---
 * LFCLK 32.768kHz 기준 100ms = 3276.8 tick (비정수).
 * 5-frame 주기로 3277 tick 4회 + 3276 tick 1회 = 16384 tick = 정확히 500ms
 * (2026-09-15 코드 리뷰로 비율이 반대로 구현돼 있던 버그 발견/수정, m_i2c_rtc.c 참고).
 */
#define RTC_LFCLK_HZ                 32768
#define RTC_TICK_TARGET_100MS_LOW    3276
#define RTC_TICK_TARGET_100MS_HIGH   3277
#define RTC_BRESENHAM_FRAME_PERIOD   5   /* HIGH tick이 나오는 주기 (5프레임 중 1회) */

#define SAMPLE_RATE_HZ  10

/* --- Wavelengths (architecture.md §5) --- */
typedef enum {
	NIRS_WAVELENGTH_640NM = 0,
	NIRS_WAVELENGTH_680NM,
	NIRS_WAVELENGTH_950NM,
	NIRS_WAVELENGTH_COUNT,
} nirs_wavelength_t;

/* --- NIR 센서 (AS7341 x2, pinmap.md §3: 각각 독립 I2C 버스) --- */
typedef enum {
	NIR_SENSOR_1 = 0, /* &i2c1, SCL=P0.09/SDA=P0.10 */
	NIR_SENSOR_2,      /* &i2c0, SCL=P0.08/SDA=P0.07 */
	NIR_SENSOR_COUNT,
} nir_sensor_id_t;

/* --- Ring buffer (architecture.md §2.5: 100~200 샘플 원안) ---
 * [버그 수정, 2026-09-21] 원안(100~200)은 BLE notify 지연/혼잡(5~10초) 버티기만 고려한
 * 값이었는데, 이후 §11 항목6-[3] Safety 대응으로 도입된 BLE_DISCONNECT_STANDBY_TIMEOUT_TICKS
 * (연결 끊겨도 30초는 계속 측정+버퍼링)와 서로 검토 없이 따로 정해져 있었다 — 150샘플(15초
 * 분량)로는 30초 grace period의 절반도 못 버티고 앞부분 데이터가 실시간으로 덮어써져
 * 유실됐다(m_i2c_ring_buffer_push() overflow 시 가장 오래된 샘플 덮어쓰기, silent는
 * 아니지만 dropped_count만 늘고 실제로는 유실). BLE_DISCONNECT_STANDBY_TIMEOUT_TICKS를
 * 그대로 참조해 두 값이 다시 어긋나지 않게 한다(정의는 config_app.h 아래쪽, 매크로라 순서
 * 무관 — 실제 확장은 이 파일 전체가 include된 뒤 일어난다).
 */
#define RING_BUFFER_CAPACITY BLE_DISCONNECT_STANDBY_TIMEOUT_TICKS

/* --- LED 상태 시나리오 (m_i2c.c가 관리, pinmap.md §6) ---
 * SW1은 MAX16054를 통해 VBAT를 하드웨어적으로 on/off한다 — MCU에는 GPIO로 연결되어
 * 있지 않다. 즉 "디바이스 On"은 곧 "부팅됨"이고, "디바이스 Off"는 전원이 물리적으로
 * 끊긴 것이라 소프트웨어로 표현할 상태가 아니다 (LED도 전원과 함께 자동 소등).
 *
 * 시나리오: 부팅(디바이스 On) → LED 3개를 1개씩 1초 간격 순차 점등(3개 LED가 밀착
 * 실장돼 있고 하나는 적외선이라 육안 개별 확인용, 2026-09-14 실기 테스트 요청) →
 * BLE 연동 성공 시 10회 점멸 → 측정 시퀀스(파장별 PWM 스트로빙,
 * m_i2c_task_entry의 acquire_one_sample) 시작.
 */
#define I2C_LED_INDICATOR_DUTY_PERMILLE 200 /* 20% duty — 개발 단계 눈부심 방지 (2026-09-15 변경, 기존 50) */

/* 디바이스 On 상태에서 LED 1개당 점등 유지 시간. RTC 100ms tick을 그대로 세므로
 * SAMPLE_RATE_HZ(10)개 tick = 1초.
 */
#define I2C_LED_DEVICE_ON_STEP_TICKS SAMPLE_RATE_HZ

/* TEMP(하드웨어 진단용, 2026-09-14): D3/D4 미점등 원인 파악을 위해 1이면 순차 점등 대신
 * 3개 LED를 100% duty로 계속 켜둔다(타이밍 걱정 없이 멀티미터로 측정 가능).
 * 진단(R17/R20 2.7V 동일, D4 육안 확인) 완료 — 순차 점등 모드로 복귀.
 * [정리, 2026-09-28] 진단 완료 후 오래 방치돼있던 훅이라 플래그/사용처를 제거했다
 * (memory_ram_optimization_plan.md 항목3).
 */

/* BLE 연동 성공 점멸 횟수. 점멸 토글은 RTC 100ms tick을 그대로 사용한다
 * (토글 1회=100ms, 점멸 1회=on+off=2 tick=200ms → 10회 점멸 = 2초).
 */
#define I2C_LED_BLE_CONNECT_BLINK_COUNT 10

/* 부팅 버전 점멸 표시 (2026-09-17, architecture.md §11 항목6-[6] OTA 검증 과정에서
 * 도입 — TEMP_OTA_TEST_MARKER를 대체하는 정식 기능). SWD/RTT 연결 없이(조립된 상태)
 * 육안으로 "부팅이 이 지점까지 정상 진행됐는지"를 확인하기 위한 기능이다.
 * 부팅 직후(디바이스 On 순차점등 진입 전) LED 3개를 동시에 FW_VERSION_BOOT_BLINK_COUNT
 * 회 점멸한다.
 * [버그 수정, 2026-09-22] 원래는 (FW_VERSION_PATCH+1)회로 패치 버전에 따라 점멸
 * 횟수가 계속 늘어나는 구조였다 — "업데이트 전/후 점멸 횟수 차이로 OTA 성공 여부
 * 확인"이 목적이었으나, PATCH가 매 패치 +1되는 정책상 버전이 쌓일수록 이 블로킹
 * 구간 자체가 계속 길어져 watchdog 타이밍과 충돌하는 버그로 실제 이어졌다(v0.1.13→
 * v0.1.14, CHANGELOG 참고). 사용자 결정으로 고정 3회로 변경 — OTA 적용 여부 확인은
 * 이제 BLE `AS7341_VERSION` characteristic(0x1528)으로 fw_version을 읽는 방식을
 * 사용한다(앱이 이미 지원). 이 점멸은 "부팅이 여기까지 왔다"는 생존 신호 용도로만
 * 남는다.
 */
#define FW_VERSION_BOOT_BLINK_MS 150
#define FW_VERSION_BOOT_BLINK_COUNT 3

/* TEMP(개발용, 2026-09-15): AS7341 채널-파장 매핑 실측 검증용. 1이면 BLE 연동 대기 없이
 * 부팅 즉시 측정 시퀀스(acquisition)로 진입해서 raw 채널 값을 RTT로 바로 확인할 수 있다.
 * 실제 BLE(Rev2)가 준비되기 전까지의 임시 우회이며, 검증 끝나면 0으로 되돌린다.
 */
#define TEMP_AS7341_READ_TEST 0

/* [정리, 2026-09-28] RTC tick 주기 실측(TEMP_RTC_TICK_LOG_TEST)과 BLE 스택 격리 진단
 * (TEMP_BLE_DISABLE_TEST) 훅은 둘 다 2026-09-15 당시 문제를 검증/해결한 뒤 0으로
 * 방치돼있던 초기 개발용 임시 코드라 플래그/사용처를 제거했다
 * (memory_ram_optimization_plan.md 항목3).
 */

/* TEMP(개발용, 2026-09-16): 테스트 APK로 수신되는 DATA0/DATA1 raw 값이 AS7341이 실제로
 * 읽은 값과 일치하는지 검증하기 위해, RTT 로그(m_i2c_as7341.c의 F5~NIR LOG_DBG)를
 * 앱 연동 중에도 확인할 수 있게 임시로 로그 레벨을 올린다. 검증 끝나면 0으로 되돌린다.
 */
#define TEMP_AS7341_RAW_DBG_LOG 1

/* Watchdog (Rev3, R3-1, 2026-09-16): m_i2c/m_ble Task가 각자 루프마다 m_ctrl_notify_alive()로
 * 생존 신호를 보내고, m_ctrl은 둘 다 최근 WATCHDOG_ALIVE_STALE_MS 이내에 응답했을 때만
 * 하드웨어 watchdog을 feed한다 — I2C 버스 hang 등으로 한쪽이라도 멈추면 feed가 끊겨서
 * SoC가 자동 리셋된다. 온도/배터리 센서가 없는 PoC v1 보드(architecture.md §11)에서
 * 구현 가능한 유일한 Rev3 안전장치라 우선 적용한다.
 * TIMEOUT은 AS7341 STATUS2 폴링 최악 케이스(NIR1+NIR2 순차 최대 400ms, CHANGELOG 참고)와
 * RTC 100ms tick 주기에 충분한 여유를 둔 값 — 실측 후 필요하면 조정한다.
 */
#define WATCHDOG_TIMEOUT_MS 4000
#define WATCHDOG_ALIVE_STALE_MS 1000
#define WATCHDOG_CHECK_PERIOD_MS 500

/* --- Sensor(AS7341) fault recovery (Rev3 R3-1, 2026-09-28) ---
 * I2C 트리거/읽기 실패(MODULE_ERR_I2C_TIMEOUT) 시 하드웨어 watchdog(위)이 SoC 전체를
 * 리셋할 때까지 기다리지 않고, 먼저 AS7341 재초기화(WHOAMI+SMUX 재구성, i2c_recover_bus
 * 포함 — m_i2c_as7341_init() 참고)로 자체 복구를 시도한다. 연속 실패가 이 횟수에
 * 도달해야만 진짜 하드웨어 고장으로 판단해 `m_ctrl_report_error()`로 에스컬레이션한다
 * (그 뒤 처리는 아래 CTRL_MODULE_FAULT_REBOOT_MAX 참고) — 일시적 I2C 글리치까지 곧장
 * 정지시키지 않기 위함(m_i2c.c recover_as7341_or_escalate() 참고).
 */
#define I2C_FAULT_RECOVERY_MAX_ATTEMPTS 3

/* --- 모듈 오류 재부팅 에스컬레이션 (2026-09-29, TedreamS2 재시도 로직 참고 적용) ---
 * `m_ctrl_report_error()`로 보고된 오류가 기존에는(v0.1.31까지) 확인 즉시
 * CTRL_STATE_DEGRADED로 영구 래치(재부팅해야만 해제)됐는데, 사용자 결정에 따라
 * TedreamS2 재시도 로직을 우리 구조에 맞게 변형해 적용한다: 이 횟수만큼은 먼저
 * 소프트웨어 재부팅(`m_ctrl_request_reset()`)으로 복구를 시도해보고, 그래도 같은
 * 계열의 오류가 재발하면 그때 비로소 영구 안전상태로 전환한다(`m_ctrl.c
 * escalate_or_reboot()` 참고). 재부팅 횟수는 GPREGRET(POR 전에는 지워지지 않는
 * 레지스터)에 저장 — 즉 "물리적으로 전원을 껐다 켜야만" 카운트가 초기화된다
 * (TedreamS2의 "재부팅 3회도 실패하면 전원 off" 4단계를, 우리 보드는 SW로 전원을
 * 끌 수 없어(물리 SW1뿐) "더 이상 재부팅하지 않는 영구 정지"로 대체한 것).
 * **주의**: 이 카운트는 부팅 세션 내내 누적되며 성공적으로 복구돼도 리셋되지
 * 않는다(TedreamS2 원 로직 그대로) — 서로 무관한 오류 3번이 쌓여도 마지막엔 영구
 * 정지된다. 의료기기 단일고장 안전 철학(IEC 60601)과의 정합성은 아직 정식
 * 검토되지 않은 상태 — TODO(open-item, architecture.md §11 규제 항목과 연결).
 */
#define CTRL_MODULE_FAULT_REBOOT_MAX 3

/* TEMP(watchdog 실기 fault injection 테스트용, 2026-09-17): 1이면 m_i2c 태스크가
 * 부팅 후 TEMP_WATCHDOG_FAULT_INJECT_TICKS번째 tick에서 완전히 멈춘다(m_ctrl_notify_alive
 * 호출 중단) — feed_watchdog_if_alive()가 stale을 감지해 feed를 멈추고, WATCHDOG_TIMEOUT_MS
 * 후 하드웨어가 SoC를 강제 리셋하는지, 재부팅 후 log_reset_cause()가 이 리셋을
 * watchdog으로 정확히 로그하는지 확인하기 위함. 검증 끝나면 반드시 0으로 되돌린다.
 */
#define TEMP_WATCHDOG_FAULT_INJECT_TEST 0
#define TEMP_WATCHDOG_FAULT_INJECT_TICKS 20

/* Safety 인증 대응(2026-09-17, architecture.md §11 항목6-[3]): BLE 연결이 끊겨도
 * 즉시 측정을 멈추지 않고 ring buffer에 계속 버퍼링하다가, 이 tick 수를 넘겨도 재연결이
 * 안 되면 저전력 대기모드(I2C_LED_MODE_STANDBY)로 전환한다. RTC tick = 100ms(SAMPLE_RATE_HZ)
 * 기준. 제품 정책값 아님 — 실측 후 조정 가능한 초기값이다.
 * [버그 수정, 2026-09-21] 원래 300 tick(30초)이었으나 RING_BUFFER_CAPACITY(위 §2.5)가
 * 이 값을 그대로 참조하도록 묶으면서, RAM 예산(nRF52832 64KB) 안에서 안전 마진을 두고
 * 감당 가능한 220 tick(22초)으로 낮췄다 — 300으로 두면 Application 이미지 RAM 사용률이
 * 96.07%(여유 2.5KB)까지 올라가 스택 오버플로우 등 위험이 있음을 실측 확인(2026-09-21,
 * 사용자 결정: grace period를 버퍼가 감당 가능한 수준으로 단축). 220으로는 RAM 사용률
 * 약 90%대 유지, 22초 내내 데이터 유실 없이 보장된다(그 이상 끊기면 STANDBY 진입 후 측정
 * 자체가 중단되므로 추가 유실 없음, 아래 STANDBY 전환 로직 참고).
 */
#define BLE_DISCONNECT_STANDBY_TIMEOUT_TICKS 220

/* STANDBY 중 "살아있음 + 연결 대기 중"을 알리는 저전력 점멸 패턴 — LED1(640nm)만
 * BLE_STANDBY_BLINK_PERIOD_TICKS(2초)마다 BLE_STANDBY_BLINK_ON_TICKS(100ms) 짧게 켠다.
 */
#define BLE_STANDBY_BLINK_PERIOD_TICKS 20
#define BLE_STANDBY_BLINK_ON_TICKS 1

/* Safety 인증 대응(2026-09-17, architecture.md §11 항목6-[4]): AS7341 채널 raw 값
 * sanity check 임계값. LOW_SIGNAL은 노이즈 플로어 근접값으로 판정한다.
 * [정정, 2026-09-28] SATURATION은 더 이상 이 고정 임계값으로 판정하지 않는다 —
 * AS7341 STATUS2의 ASAT_ANALOG/ASAT_DIGITAL 비트(하드웨어가 게인/적분시간과 무관하게
 * 직접 판정, m_i2c_as7341.c read_raw()/m_i2c.c check_sensor_sanity() 참고)로 대체돼
 * "채널별/게인별 정확한 풀스케일 계산" TODO 자체가 해소됐다.
 */
#define AS7341_LOW_SIGNAL_THRESHOLD 10

/* --- Ambient light 제거(dark-frame subtraction, 2026-09-28, 비율 2026-09-29 조정) ---
 * lit(정상 측정) 샘플 DARK_FRAME_LIT_INTERVAL개마다 다크 프레임(LED 전부 OFF, 같은
 * gain/ATIME/ASTEP)을 1개 추가로 삽입한다. 다크(주변광+dark current)는 생리신호(맥동)보다
 * 훨씬 느리게 변하므로 lit과 1:1로 잴 필요가 없다는 원칙은 그대로 유지.
 * [2026-09-29] 원래 10:1이었는데, dark 기준점의 최신성(정밀도)을 조금 더 높이기 위해
 * 3:1로 변경 — 절충안(사용자 결정). 주의: dark 프레임은 별도 tick이 아니라 해당 활성
 * tick 안에서 lit 측정 직후 추가로 한 번 더 트리거+적분하는 방식(m_i2c.c acquire_common()
 * 호출부 참고)이라, 이 값을 낮출수록 AS7341/I2C 활성 듀티가 유의미하게 늘어난다(10:1일 때
 * 평균 활성 듀티 약 36% → 3:1일 때 약 43%, 1:1이면 약 66%까지 증가 — 실측 없이 추정한
 * 구조적 계산이며 실측 검증 필요). BLE 전송량도 그만큼 늘어나므로 §6 전력 최적화
 * 항목(TX power/batch flush interval)과 함께 검토해서 정함 — 2026-09-29 대화 참고.
 * lit 샘플레이트/ring buffer 용량(RING_BUFFER_CAPACITY, 위 §2.5)에는 영향 없음 — 정적
 * 배열 크기가 아니라 실제 push 빈도만 늘어나는 것이라 기존 용량 여유로 흡수된다.
 */
#define DARK_FRAME_LIT_INTERVAL 3

#ifdef __cplusplus
}
#endif

#endif /* CONFIG_APP_H_ */
```

## src/m_ble.c
```c
#include <zephyr/kernel.h>
#include <zephyr/logging/log.h>
#include <zephyr/bluetooth/bluetooth.h>
#include <zephyr/bluetooth/conn.h>
#include <zephyr/bluetooth/gap.h>
#include <zephyr/bluetooth/gatt.h>
#include <zephyr/sys/byteorder.h>
#include <errno.h>
#include "m_ble.h"
#include "m_ble_gatt.h"
#include "m_ble_proto.h"
#include "m_i2c.h"
#include "m_i2c_ring_buffer.h"
#include "m_ctrl.h"
#include "config_app.h"

LOG_MODULE_REGISTER(m_ble, LOG_LEVEL_INF);

/* BLE 지연/재연결 대기 중에도 ring buffer를 계속 소비할 수 있도록 짧은 주기로 polling한다.
 * TODO(open-item): Rev2에서 실제 GATT notify 완료 콜백/큐 기반으로 event-driven 전환.
 */
#define BLE_POLL_INTERVAL_MS 20

/* [버그 수정, 2026-09-21] 재연결 후 ring buffer 백로그(최대 220샘플, config_app.h
 * BLE_DISCONNECT_STANDBY_TIMEOUT_TICKS)를 텀 없이 몰아서 notify하면 Zephyr BLE 스택의
 * ATT 송신 버퍼 풀이 실제 무선 전송 속도보다 빨리 고갈되어 bt_gatt_notify()가 일시적으로
 * -ENOMEM을 반환할 수 있다 — flush_batch()가 이 경우 감지 시(congested) 다음 배치
 * 전송 전에 짧게 대기해서 컨트롤러가 큐를 비울 시간을 준다. */
#define BLE_NOTIFY_CONGESTION_BACKOFF_MS 20

/* [전력 최적화, 2026-09-22] 배치 flush 주기 — "몇 개를 묶을지"는 협상된 MTU가 결정하지만
 * (s_batch_capacity, 프레임 하나에 들어가는 개수), "얼마나 자주 무선을 깨워서 보낼지"는
 * 이 값이 별도로 통제한다. 사용자와 논의 후 결정: 센싱 주기(cycle/active 게이팅에 따라
 * 들쭉날쭉할 수 있음)가 아니라, 전력 절감이 실제로 통제해야 하는 대상인 "무선 송신
 * 빈도" 기준으로 고정 — MTU 협상이 실패해 프레임당 1개씩만 담기는 상황(capacity=1)에도
 * 매 tick(100ms)마다 즉시 전송되는 걸 막아준다(이 경우 이 주기 동안 쌓인 걸 여러 프레임
 * 으로 나눠 한 번에 몰아서 보냄 — 아래 m_ble_task_entry() 참고). 실시간성/배터리
 * 트레이드오프의 초기값 — AT-06 전류소비 실측 후 조정 가능.
 * [2026-09-29] 1000ms → 2000ms로 연장 — dark:lit 비율을 3:1로 낮춘 것과 맞물려 배터리
 * 목표(12h)를 지키기 위한 전력 최적화. 지금 샘플레이트(dark 3:1 기준 약 4.4/s)에서
 * 1000ms 주기면 배치 용량(17개, ATT MTU 협상 후 기준)의 극히 일부(약 4~5개)만 채운 채
 * 매초 무선을 깨우고 있었다 — 2000ms로 늘리면 한 번에 약 9개를 채워서 보내 무선 송신
 * 횟수를 줄인다(실시간성은 그만큼 늦어짐 — 오버나이트 수면측정 용도라 수용 가능하다고
 * 판단). 3000ms(약 13개)까지 더 늘릴 수 있는 여지가 있으나, 우선 2000ms로 보수적으로
 * 시작해서 실측 후 필요하면 더 늘리기로 함(2026-09-29 사용자 결정). 실측 검증 필요.
 */
#define BLE_BATCH_FLUSH_INTERVAL_MS 2000

/* notify 대상 연결 — on_connected/on_disconnected에서만 갱신(BLE Task 컨텍스트 단일 소비). */
static struct bt_conn *s_conn;

/* §6(codingstandard.md): notify 실패를 silent하게 버리지 않기 위한 카운터.
 * 연결 안 됨/notify 미구독 상태의 실패는 정상 상태이므로 별도(s_notify_skip_count)로 센다. */
static uint32_t s_notify_drop_count;
static uint32_t s_notify_skip_count;

/* [전력 최적화, 2026-09-21] 배치 크기 — 연결마다 MTU exchange 콜백에서 실제 협상된
 * ATT MTU 기준으로 다시 계산한다. 협상 전/실패 시 1(=배칭 없음, 그러나 프레임 포맷은
 * 동일하게 header+record 1개)로 안전하게 동작한다. mtu_exchange_cb()(BT RX 스레드)가
 * 쓰고 m_ble_task_entry()(BLE Task)가 읽는 cross-context 값이라 volatile로 충분하다
 * (g_ble_connected와 동일 근거, codingstandard.md §8 — 단순 대입/읽기뿐, 복합 연산 없음). */
static volatile uint16_t s_batch_capacity = 1;

/* [전력 최적화, 2026-09-21] 배치용 임시 버퍼 — ring buffer에서 뽑아 모아뒀다가 한 번에
 * notify한다. **의도적으로 "필요한 만큼만 한 번에 pop"하는 구조**를 쓴다(아래
 * m_ble_task_entry() 참고) — 한 샘플씩 여러 loop 반복에 걸쳐 누적하면, 그 사이 연결이
 * 끊길 경우 이미 ring buffer에서 빠져나온 샘플들이 재연결 안전장치(§11 항목6-[3]
 * ring buffer 버퍼링) 밖에 놓여 유실될 수 있다 — 배치가 다 찼거나 flush timeout이 된
 * 순간에만 pop+즉시 notify를 함께 수행해서 이 위험 구간을 최소화한다. */
static nirs_sample_t s_batch[BLE_PROTO_BATCH_MAX_SAMPLES];
static uint16_t s_batch_count;

/* 테스트 APK(fnirs-visualizer-app-release.apk) 호환용 advertising — AS7341_SERVICE_UUID로
 * 광고해서 APK가 스캔 필터로 찾을 수 있게 한다 (m_ble_gatt.h 상단 주석 참고).
 */
static const struct bt_data s_adv_data[] = {
	BT_DATA_BYTES(BT_DATA_FLAGS, (BT_LE_AD_GENERAL | BT_LE_AD_NO_BREDR)),
	BT_DATA_BYTES(BT_DATA_UUID128_ALL, BT_UUID_AS7341_SERVICE_VAL),
};

static const struct bt_data s_scan_rsp_data[] = {
	BT_DATA(BT_DATA_NAME_COMPLETE, CONFIG_BT_DEVICE_NAME, sizeof(CONFIG_BT_DEVICE_NAME) - 1),
};

/* bt_enable() 직후(ble_init())와 연결 해제 후(on_disconnected()) 양쪽에서 호출된다.
 * Zephyr peripheral은 연결되면 advertising이 자동 중단되고 연결 해제 후 자동으로
 * 재시작되지 않으므로, 앱이 다시 스캔/연결할 수 있게 매번 명시적으로 시작해야 한다.
 */
static int start_advertising(void)
{
	int err = bt_le_adv_start(BT_LE_ADV_CONN_FAST_1, s_adv_data, ARRAY_SIZE(s_adv_data),
				   s_scan_rsp_data, ARRAY_SIZE(s_scan_rsp_data));

	if (err != 0) {
		LOG_ERR("bt_le_adv_start failed (err=%d)", err);
		return err;
	}

	LOG_INF("BLE advertising started (AS7341_SERVICE_UUID, device name %s)",
		CONFIG_BT_DEVICE_NAME);

	return 0;
}

/* disconnected 콜백 안에서 bt_le_adv_start()를 바로 호출하면, SoftDevice Controller가
 * 연결 해제 HCI 이벤트 처리를 아직 마무리하는 도중이라 광고 시작이 조용히(-EAGAIN 등)
 * 실패할 수 있음을 실기에서 확인(2026-09-16) — LED는 정상적으로 처음 상태로 복귀하는데
 * advertising만 안 돌아오는 증상으로 나타남. 시스템 워크큐로 한 틱 미뤄서 재시작한다.
 */
static void adv_restart_work_handler(struct k_work *work)
{
	ARG_UNUSED(work);

	int err = start_advertising();

	if (err != 0) {
		m_ctrl_report_error(MODULE_ERR_NOT_INITIALIZED);
	}
}

K_WORK_DEFINE(s_adv_restart_work, adv_restart_work_handler);

/* [전력 최적화, 2026-09-21] connection interval을 늘리고 peripheral latency로 유휴
 * connection event를 건너뛰게 하면, 배칭으로 notify 빈도를 줄인 효과가 실제 라디오
 * 절전으로 이어진다(배칭만 하고 이걸 안 하면 라디오는 여전히 자주 깨어나 보낼 데이터가
 * 없는 채로 연결 이벤트만 처리하게 됨). architecture.md §2.4가 원래부터 "S2 선례
 * 범위(7.5~30ms)에서 실측 후 확정"이라고 열어둔 값 — 지금은 그 범위 내 초기값이고,
 * 실측(AT-06 전류소비 검증) 후 조정 필요.
 */
#define BLE_CONN_INTERVAL_UNITS 24  /* 24 × 1.25ms = 30ms */
#define BLE_CONN_LATENCY 4          /* 유휴 시 연결 이벤트 4/5 스킵 → 실효 wake ~150ms */
#define BLE_CONN_TIMEOUT_UNITS 400  /* 400 × 10ms = 4000ms (latency 감안 최소 마진 확보) */

static void mtu_exchange_cb(struct bt_conn *conn, uint8_t err, struct bt_gatt_exchange_params *params)
{
	ARG_UNUSED(conn);
	ARG_UNUSED(params);

	if (err != 0) {
		LOG_WRN("ATT MTU exchange 실패(err=%u) — 배치 크기 1로 유지(협상 전 기본값)", err);
		return;
	}

	uint16_t att_mtu = bt_gatt_get_mtu(s_conn);
	uint16_t att_payload = (att_mtu > 3) ? (att_mtu - 3) : 0;
	uint16_t capacity = att_payload / BLE_PROTO_BATCH_RECORD_LEN;

	if (capacity < 1) {
		capacity = 1;
	} else if (capacity > BLE_PROTO_BATCH_MAX_SAMPLES) {
		capacity = BLE_PROTO_BATCH_MAX_SAMPLES;
	}

	s_batch_capacity = capacity;
	LOG_INF("ATT MTU=%u -> 배치 크기=%u샘플/notify (전력 최적화, 2026-09-21)", att_mtu,
		s_batch_capacity);
}

static struct bt_gatt_exchange_params s_mtu_params = {
	.func = mtu_exchange_cb,
};

static void on_connected(struct bt_conn *conn, uint8_t err)
{
	if (err != 0) {
		LOG_ERR("BLE connection failed (err=0x%02X)", err);
		return;
	}

	LOG_INF("BLE connected");

	/* DATA0/DATA1 notify 대상 conn을 보관한다 — bt_conn_ref()로 참조를 잡아둬야
	 * 콜백 리턴 이후에도(다음 notify 호출 시점까지) 유효하다. */
	s_conn = bt_conn_ref(conn);

	/* MTU 협상 전까지는 배치 크기를 안전하게 1로 되돌린다 — 이전 연결에서 얻은 값을
	 * 새 연결(다른 중앙기기/앱)에 그대로 쓰면 안 되기 때문. */
	s_batch_capacity = 1;
	s_batch_count = 0;

	int mtu_err = bt_gatt_exchange_mtu(conn, &s_mtu_params);

	if (mtu_err != 0) {
		LOG_WRN("bt_gatt_exchange_mtu 요청 실패(err=%d) — 배치 크기 1로 유지", mtu_err);
	}

	/* [전력 최적화, 2026-09-21] MTU 협상만으로는 실제 무선 PDU 크기가 커지지 않는다 —
	 * LE Data Length Update로 컨트롤러가 협상된 크기(최대 251byte)를 실제로 쓰게
	 * 요청한다. 요청하지 않아도 중앙기기가 먼저 시작할 수 있으나(대부분의 최신 폰),
	 * 테스트 APK가 그렇게 안 할 가능성에 대비해 우리가 먼저 요청한다. */
	if (IS_ENABLED(CONFIG_BT_USER_DATA_LEN_UPDATE)) {
		int dle_err = bt_conn_le_data_len_update(conn, BT_LE_DATA_LEN_PARAM_MAX);

		if (dle_err != 0) {
			LOG_WRN("bt_conn_le_data_len_update 요청 실패(err=%d)", dle_err);
		}
	}

	/* [전력 최적화, 2026-09-21] connection interval/peripheral latency 조정 요청 —
	 * 위 BLE_CONN_* 주석 참고. 중앙기기가 거부/재협상할 수 있다(요청일 뿐 강제 아님). */
	struct bt_le_conn_param conn_param = BT_LE_CONN_PARAM_INIT(
		BLE_CONN_INTERVAL_UNITS, BLE_CONN_INTERVAL_UNITS, BLE_CONN_LATENCY,
		BLE_CONN_TIMEOUT_UNITS);
	int param_err = bt_conn_le_param_update(conn, &conn_param);

	if (param_err != 0) {
		LOG_WRN("bt_conn_le_param_update 요청 실패(err=%d)", param_err);
	}

	/* m_i2c는 이 신호를 polling해서 "디바이스 On 순차점등 -> BLE 10회 점멸 -> 측정"
	 * 전환 시점을 판단한다 (m_ctrl.h 참고, Acquisition/BLE 직접 결합 금지).
	 */
	m_ctrl_notify_ble_connected();
}

static void on_disconnected(struct bt_conn *conn, uint8_t reason)
{
	ARG_UNUSED(conn);

	LOG_INF("BLE disconnected (reason=0x%02X)", reason);

	if (s_conn != NULL) {
		bt_conn_unref(s_conn);
		s_conn = NULL;
	}

	/* m_i2c는 이 신호로 "측정 시퀀스 -> 처음 상태(디바이스 On 순차점등)"로 되돌아간다
	 * (m_ctrl.h 참고, 2026-09-16 R2-2 재연결 시나리오 구현). 연결이 끊긴 뒤에도 기기가
	 * 계속 센싱하던 문제 수정.
	 */
	m_ctrl_notify_ble_disconnected();

	/* Zephyr peripheral은 연결되면 advertising이 자동으로 중단되고, 연결 해제 후
	 * 자동으로 재시작되지 않는다 — 앱이 다시 스캔/연결할 수 있도록 재시작해야 한다.
	 * 이 콜백 컨텍스트에서 직접 호출하지 않고 워크큐로 미룬다(위 주석 참고). */
	k_work_submit(&s_adv_restart_work);
}

BT_CONN_CB_DEFINE(m_ble_conn_callbacks) = {
	.connected = on_connected,
	.disconnected = on_disconnected,
};

/* main()에서 호출하지 않는다 — m_ble_task_entry() 진입 직후 태스크 컨텍스트에서
 * 1회 수행한다 (S2 task_i2c 관례: 드라이버/스택 init은 생성된 task 안에서 진행).
 */
static module_err_t ble_init(void)
{
	m_ble_gatt_init();
	m_ble_proto_init();

	/* AS7341 I2C 초기화가 끝날 때까지 대기 — bt_enable()이 I2C1 SMUX 폴링 도중
	 * 끼어들면 트랜잭션이 멈추는 경합이 확인됨(m_i2c.h 상단 주석 참고, 2026-09-15).
	 * [버그 수정, 2026-09-21] K_FOREVER로 블로킹하면 이 태스크는 m_ctrl_notify_alive
	 * (CTRL_ALIVE_BLE)를 아래 메인루프 진입 전까지 한 번도 호출하지 못한다 — I2C 쪽
	 * 초기화(버전 점멸 등)가 길어지면 watchdog이 두 소스 모두 stale로 보고 리셋시키는
	 * 문제가 있었다(m_i2c.c i2c_init() 버전 점멸 루프 주석 참고). 짧은 타임아웃으로
	 * 나눠 기다리며 매번 alive를 보고해 실제로 멈춘 게 아닌 정상 대기 중임을 알린다. */
	while (k_sem_take(&sem_i2c_init_done, K_MSEC(200)) != 0) {
		m_ctrl_notify_alive(CTRL_ALIVE_BLE);
	}

	int err = bt_enable(NULL);

	if (err != 0) {
		LOG_ERR("bt_enable failed (err=%d)", err);
		return MODULE_ERR_NOT_INITIALIZED;
	}

	if (start_advertising() != 0) {
		return MODULE_ERR_NOT_INITIALIZED;
	}

	/* [전력 최적화, 2026-09-21] MTU 협상/배칭/connection param 조정은 on_connected()에서
	 * 연결마다 수행한다(위 mtu_exchange_cb()/BLE_CONN_* 참고) — S2 정책(§2.4)의 MTU
	 * 251byte 목표를 이제 채택. TX power -8dBm은 prj.conf의
	 * CONFIG_BT_CTLR_TX_PWR_MINUS_8로 적용한다.
	 */
	return MODULE_ERR_OK;
}

/* NIR1(DATA0)/NIR2(DATA1)를 각각 배칭 프레임(m_ble_proto.h v3 스펙)으로 인코드해서
 * notify한다. [전력 최적화, 2026-09-21] 샘플마다 즉시 notify하던 것을 s_batch에 모아
 * 한 번에 보내는 구조로 변경 — 반환값 true = 일시적 혼잡(-ENOMEM) 감지, 호출부가
 * 다음 배치 전송 전에 backoff해야 함.
 */
static bool notify_batch(nir_sensor_id_t sensor_id,
			  int (*notify_fn)(struct bt_conn *, const uint8_t *, uint16_t))
{
	uint8_t frame[BLE_PROTO_MAX_PACKET_LEN];

	uint16_t len = m_ble_proto_encode_batch(sensor_id, s_batch, s_batch_count, frame,
						 sizeof(frame));

	if (len == 0) {
		LOG_ERR("배치 인코드 실패(sensor=%d, count=%u) — 이번 배치 폐기", sensor_id,
			s_batch_count);
		return false;
	}

	int err = notify_fn(s_conn, frame, len);

	if (err == 0) {
		return false;
	}

	if (err == -ENOTCONN || err == -EINVAL) {
		/* 정상 상태(진짜 실패 아님) — §6에 따라 silent하게 버리지 않고 카운터만
		 * 증가시킨다. -ENOTCONN=연결 전/해제 후. -EINVAL=앱이 아직 notify를
		 * 구독(CCC)하지 않은 상태 — Zephyr bt_gatt_notify()가 실제로 이 에러코드를
		 * 쓴다(gatt.c gatt_notify(): !bt_gatt_is_subscribed() 시 -EINVAL 반환,
		 * "통신 실패"가 아니다). 2026-09-17 실기 검증 중 발견: 이전에는 -EINVAL을
		 * 진짜 실패로 오분류해서 MODULE_ERR_BLE_TX_FAILED를 계속 보고했고, 이게
		 * m_ctrl_is_safe_state() 도입 이후로는 앱이 연결만 하고 아직 구독 전인
		 * 정상적인 과도 상태에서 측정을 영구 중단시키는 회귀로 이어질 뻔했다.
		 * 배칭 도입 후에는 실패 시 배치 전체(최대 17샘플)를 한 번에 잃는다는
		 * 점이 단일 샘플 시절과의 차이 — 그래도 여전히 "통신 실패"가 아니라
		 * 카운터만 증가시킨다(§6). */
		s_notify_skip_count++;
		return false;
	}

	if (err == -ENOMEM) {
		/* [버그 수정, 2026-09-21] TX 버퍼 풀 고갈 — architecture.md §11 항목6-[4]가
		 * 이미 "notify는 ACK 없는 fire-and-forget이라 개별 패킷이 무해하게 유실될
		 * 수 있다"고 규정한 것과 같은 성격의 일시적 혼잡이지, 진짜 통신 장애가
		 * 아니다. 재연결 후 ring buffer 백로그(최대 220샘플)를 몰아서 보낼 때
		 * 재현 가능성이 높다. 이걸 MODULE_ERR_BLE_TX_FAILED로 보고하면
		 * CTRL_STATE_DEGRADED로 래치되어(m_ctrl.c) m_i2c 태스크가 측정을 완전히
		 * 멈추고 재부팅 전까지 복구 안 됨 — 정상적인 백로그 flush 상황에서 이
		 * 안전상태 래치가 오발동하는 심각한 회귀였다. -ENOTCONN/-EINVAL과 같은
		 * skip 처리하되, 호출부가 backoff할 수 있게 true를 반환한다. */
		s_notify_skip_count++;
		return true;
	}

	s_notify_drop_count++;
	LOG_WRN("BLE 배치 notify 실패(sensor=%d, err=%d, count=%u), drop_count=%u", sensor_id,
		err, s_batch_count, s_notify_drop_count);
	m_ctrl_report_error(MODULE_ERR_BLE_TX_FAILED);
	return false;
}

/* s_batch에 모인 샘플을 DATA0/DATA1 두 characteristic에 각각 배치 notify로 보내고
 * 카운터를 리셋한다. 호출부(m_ble_task_entry)가 "배치가 다 찼거나 flush timeout이
 * 지났을 때"만 호출한다. */
static bool flush_batch(void)
{
	if (s_batch_count == 0) {
		return false;
	}

	bool congested = false;

	congested |= notify_batch(NIR_SENSOR_1, m_ble_gatt_notify_data0);
	congested |= notify_batch(NIR_SENSOR_2, m_ble_gatt_notify_data1);

	s_batch_count = 0;

	return congested;
}

K_SEM_DEFINE(sem_ble_init_done, 0, 1);

void m_ble_task_entry(void *p1, void *p2, void *p3)
{
	ARG_UNUSED(p1);
	ARG_UNUSED(p2);
	ARG_UNUSED(p3);

	module_err_t init_err = ble_init();

	/* 성공/실패 무관하게 항상 1회 give — m_i2c.c가 RTC 시작을 이 신호로 대기한다
	 * (m_ble.h 상단 주석 참고, 2026-09-15 bt_enable()/RTC2 경합 수정). */
	k_sem_give(&sem_ble_init_done);

	if (init_err != MODULE_ERR_OK) {
		m_ctrl_report_error(init_err);
		k_sleep(K_FOREVER); /* BLE stack 없이는 이 태스크가 할 일이 없다 */
	}

	/* [전력 최적화, 2026-09-22] 마지막으로 flush한 시각 — BLE_BATCH_FLUSH_INTERVAL_MS
	 * 간격을 강제하는 기준점. 0이면 "아직 한 번도 flush 안 함"이 아니라 그냥 k_uptime_get()
	 * 기준 과거이므로 최초 데이터 도착 시 바로 flush 조건을 만족한다(문제 없음). */
	int64_t last_flush_uptime = 0;

	while (1) {
		/* Safety 인증 대응(2026-09-17, architecture.md §11 항목6-[3]): 연결이 끊긴
		 * 동안에는 pop하지 않는다 — ring buffer는 이미 overflow 시 가장 오래된
		 * 샘플을 덮어쓰므로(m_i2c_ring_buffer.c), pop을 멈추기만 해도 "짧은 끊김
		 * 동안 로컬 버퍼링 지속"이 자연히 동작한다. m_i2c.c는 끊긴 동안에도 계속
		 * acquire+push한다(reset_to_device_on() 즉시 호출 안 함, m_i2c.c 참고).
		 */
		uint32_t available = m_ctrl_is_ble_connected() ? m_i2c_ring_buffer_count() : 0;
		int64_t now = k_uptime_get();

		if (available == 0 || (now - last_flush_uptime) < BLE_BATCH_FLUSH_INTERVAL_MS) {
			/* 아직 flush 주기가 안 됐거나 보낼 데이터가 없다 — ring buffer에 그대로
			 * 두고(pop하지 않음, 위 주석 참고) 짧게 기다렸다가 다시 확인한다. */
			k_sleep(K_MSEC(BLE_POLL_INTERVAL_MS));
			m_ctrl_notify_alive(CTRL_ALIVE_BLE);
			continue;
		}

		/* [전력 최적화, 2026-09-22] flush 주기가 됐다 — 지금까지 쌓인 걸 전부 비운다.
		 * 한 프레임(s_batch_capacity, MTU가 결정)보다 많이 쌓였으면 여러 프레임으로
		 * 나눠서 이 한 번의 "무선 깨우는 시점"에 몰아 보낸다 — MTU 협상이 잘 안 돼
		 * capacity가 작아도(최악 1), 무선을 깨우는 빈도 자체는 이 루프 한 바퀴로
		 * 통제된다(매 tick마다 즉시 전송되던 문제 방지).
		 */
		uint16_t capacity = s_batch_capacity;

		while (available > 0) {
			uint16_t to_pop = (available < capacity) ? (uint16_t)available : capacity;

			s_batch_count = 0;
			while (s_batch_count < to_pop && m_i2c_ring_buffer_pop(&s_batch[s_batch_count])) {
				s_batch_count++;
			}

			if (s_batch_count == 0) {
				break; /* pop 실패(경쟁 상태로 그 사이 비었음) — 방어적 탈출 */
			}

			bool congested = flush_batch();

			available -= s_batch_count;

			if (congested) {
				/* [버그 수정, 2026-09-21] ATT 송신 버퍼 풀 고갈 시 다음 프레임을
				 * 곧바로 또 시도하면 혼잡이 반복될 수 있다 — 짧게 대기해서
				 * 컨트롤러가 큐를 비울 시간을 준다(위 notify_batch() 주석 참고). */
				k_sleep(K_MSEC(BLE_NOTIFY_CONGESTION_BACKOFF_MS));
			}
		}

		last_flush_uptime = k_uptime_get();

		/* Watchdog(Rev3, R3-1) 생존 신호 (m_ctrl.h 참고). */
		m_ctrl_notify_alive(CTRL_ALIVE_BLE);
	}
}

/* main()에서 생성하지 않는다 — 커널 시작 시 자동 등록/스케줄링된다. */
K_THREAD_DEFINE(m_ble_tid, BLE_TASK_STACK_SIZE, m_ble_task_entry, NULL, NULL, NULL,
		 BLE_TASK_PRIORITY, 0, 0);
```
